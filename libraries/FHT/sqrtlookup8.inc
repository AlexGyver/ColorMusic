/*
 sqrtlookup8.inc
 guest openmusiclabs 8.7.12
 sqrt lookup table for 16b unsigned input values
 returns an 8b unsigned value
 this table is optimized for the fft program
 as the max value the sum of 2 squares can return is $8000
 so the top half is truncated off
 and then it is stretched to return 0 - 255
 the table is allocated as follows
 table0 : $000 -> $0ff : sqrt($0000 -> $00ff)
 table2 : $100 -> $17f : sqrt($0100 -> $0fff)
 table1 : $180 -> $27f : sqrt($1000 -> $7fff)

 its hacked to compensate for the $8000 problem

 sample code for doing the lookup table - not tested
 assumes data in z register

 cpi zh,$10
 brsh table2
 cpi zh,$01
 brsh table1
 rjmp done

 table2:

 lsl zl
 rol zh
 mov zl,zh
 ldi zh,$01
 rjmp done

 table1:

 swap zh
 swap zl
 andi zl,$0f
 or zl,zh
 lsr zl
 ldi zh,$02

 done:

 lpm r16,z

*/

0,1,
2,2,
3,3,
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254,255,
