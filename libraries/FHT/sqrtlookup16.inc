/*
  sqrtlookup16.inc - square root lookup table - 768 bytes
  broken into 4 sections, with padding between sections
  table0 : $000 -> $0ff : sqrt($0000 -> $00ff)
  table1 : $100 -> $17f : sqrt($0100 -> $0fff)
  table2 : $180 -> $1ff : sqrt($1000 -> $3fff)
  table3 : $200 -> $2ff   sqrt($4000 -> $ffff)
  you can easily check which bin your data falls into
  by checking which high bits are set.  it is best to
  check from high bits to low bits, as the lower bins
  require less modification for the data fetch.
 
  could be optimized by moving the tables around -
  table1 takes a lot of modifications for the fetch.
 
  sample code: assumes data is in z register - havent tested it yet
 
  cpi zh,$40
  brsh table3
  cpi zh,$10
  brsh table2
  cpi zh,$01
  brlo done
  swap zh
  swap zl
  andi zl,$0f
  or zl,zh
  lsr zl
  ldi zh,$01
  rjmp done
 
  table3:
 
  mov zl,zh
  ldi zh,$02
  rjmp done
 
  table2:
 
  lsl zl
  rol zh
  mov zl,zh
  ori zl,$80
  ldi zh,$01
 
  done:
 
  lpm r16,z
*/


0,1,
1,2,
2,2,
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255,255,
